## config/west.yml
```yaml
manifest:
  remotes:
    - name: zmkfirmware
      url-base: https://github.com/zmkfirmware
    - name: kumamuk-git
      url-base: https://github.com/kumamuk-git
    - name: arai-lab
      url-base: https://github.com/arai-lab
    - name: badjeff
      url-base: https://github.com/badjeff
    - name: iwk7273
      url-base: https://github.com/iwk7273

  projects:
    - name: zmk
      remote: zmkfirmware
      revision: v0.3-branch
      import: app/west.yml

    - name: zmk-pmw3610-driver
      remote: kumamuk-git
      revision: main

    # diagonal scroll clipper (public)
    - name: zmk-feature-xy_clipper
      remote: iwk7273
      revision: main

    # mouse gesture module (public)
    - name: zmk-mouse-gesture
      remote: arai-lab
      revision: main

  self:
    path: config
```
